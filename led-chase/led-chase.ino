#include <FastLED.h>
#include <Adafruit_GFX.h>
#include <Adafruit_SSD1306.h>

#define DEBUG
#ifdef DEBUG
  #define DEBUG_PRINT(x) Serial.println(x)
#else
  #define DEBUG_PRINT(x)
#endif

// led strip
#define NUM_LEDS 60
#define DATA_PIN 2
#define BRIGHTNESS 50
#define BUTTON_PIN 4
#define MAX_LIVES 3

// OLED
#define OLED_RESET 13 

// (Horizontal) byte array of bitmap of 128 x 32 px:
static const uint8_t badge[] PROGMEM = { 
  0x0, 0xe, 0x60, 0x0, 0x0, 0x0, 0x0, 0x0, 0x0, 0x0, 0x0, 0x0, 
  0x0, 0x0, 0x0, 0x0, 0x0, 0x1f, 0xf8, 0x0, 0x0, 0x0, 0x0, 0x0, 
  0x0, 0x0, 0x0, 0x0, 0x0, 0x0, 0x0, 0x0, 0x0, 0x3f, 0xf8, 0x0, 
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  0x0, 0x0, 0x0, 0x0, 0x0, 0x0, 0x0, 0x0, 
};

static const uint8_t medal[] PROGMEM = { 
  0xf, 0xff, 0xff, 0xf0, 0x0, 0x0, 0x0, 0x0, 0x0, 0x0, 0x0, 0x0, 
  0x0, 0x0, 0x0, 0x0, 0xf, 0xff, 0xff, 0xf0, 0x0, 0x0, 0x0, 0x0, 
  0x0, 0x0, 0x0, 0x0, 0x0, 0x0, 0x0, 0x0, 0xf, 0xff, 0xff, 0xf0, 
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  0x0, 0x0, 0x0, 0x0, 0x0, 0x0, 0x0, 0x0, 
};

CRGB leds[NUM_LEDS];
byte position = 0;
byte level = 0;
//const byte ledSpeed[] = {50, 40, 30, 20, 14, 7};
const byte ledSpeed[] = {50, 40};
const int MAX_LEVELS = sizeof(ledSpeed) / sizeof(byte);
int period = 1000;
unsigned long time_now = 0;

// initial wait to start playing
bool waiting = false;
bool findRandom = false;
byte spot = 0;

// lives count
byte lives = MAX_LIVES;

// create oled display
Adafruit_SSD1306 display(OLED_RESET);

void setup() {
  FastLED.addLeds<WS2812B, DATA_PIN, GRB>(leds, NUM_LEDS);
  FastLED.setBrightness(BRIGHTNESS);
  pinMode(BUTTON_PIN, INPUT_PULLUP);
  display.begin(SSD1306_SWITCHCAPVCC, 0x3C);
  showStart();

#ifdef DEBUG
  Serial.begin(9600);
#endif
  DEBUG_PRINT("Initializing...");
}

void loop() {
  if (level == 0) {
    restart();
    showStart();
  }
  else {
    play();
    showPlay();
  }
}

/**
 * Write welcome message to oled display
 */
void showStart() { 
  display.clearDisplay(); 
  display.setTextSize(1); //1 a 8
  display.setTextColor(WHITE); 
  display.setCursor(25, 10); 
  display.println("READY TO PLAY");
  display.setCursor(20, 20); 
  display.println("PRESS TO START..."); 
  display.display(); 
}

/**
 * Show level and lives in oled display
 */
void showPlay() { 
  display.clearDisplay(); 
  display.setTextSize(1); //1 a 8
  display.setTextColor(WHITE); 
  display.setCursor(10, 10); 
  display.print("LEVEL: ");
  display.println(level);
  display.setCursor(10, 20); 
  display.print("LIVES: ");
  display.println(lives); 
  display.display(); 
}

/**
 * Show icon badge
 */
void showBadge() {
  display.clearDisplay(); 
  display.drawBitmap(0, 0, badge, 128, 32, 1);
  display.setTextSize(1); //1 a 8
  display.setTextColor(WHITE); 
  display.setCursor(40, 10); 
  display.print("LEVEL: ");
  display.print(level);
  display.print(" de ");
  display.println(MAX_LEVELS);
  display.display();
  delay(2000);
}

/**
 * Show medal badge
 */
void showMedal() {
  display.clearDisplay(); 
  display.drawBitmap(0, 0, medal, 128, 32, 1);
  display.setTextSize(1); //1 a 8
  display.setTextColor(WHITE); 
  display.setCursor(50, 10); 
  display.println("YOU WON! ");
  display.setCursor(40, 20); 
  display.println("ALL LEVELS PASSED! ");
  display.display();
  delay(2000);
}

/**
 * Initialize game
 * Restart levels to the beginning
 */
void restart() {
  if (!waiting) {
    DEBUG_PRINT("Restarting game...");
    fill_rainbow(leds, NUM_LEDS, 50);
    FastLED.show();
    waiting = true;
  }

  if (digitalRead(BUTTON_PIN) == LOW) {
    DEBUG_PRINT("Button pressed, starting game");
    position = 0;
    findRandom = true;
    level = 1;
    delay(500);
    clearLeds();
    DEBUG_PRINT("Level: ");
    DEBUG_PRINT(level);
  }
}

/**
 * Play next level
 */
void play() {
  period = ledSpeed[level - 1];
  if (millis() > time_now + period) {
    time_now = millis();
    randomSpot();
    playRound(spot - 1, spot + 1);
  }
  if (digitalRead(BUTTON_PIN) == LOW) {
    delay(300);
    findRandom = false;
    if (position > spot - 1 && position < spot + 3) {
      DEBUG_PRINT("Button pressed ... winner!");
      winner();
    } else {
      DEBUG_PRINT("Button pressed ... loser");
      loser();
    }
  }
}

/**
 * Apagar tira de leds uno a uno
 */
void clearLeds() {
  for (byte i = 0; i < NUM_LEDS; i++) {
    leds[i] = CRGB::Black;
    delay(50);
    FastLED.show();
  }
}

/**
 * Genera un numero aleatorio y selecciona el led objetivo marcando el anterior y el siguiente
 */
void randomSpot() {
  if (findRandom) {
    spot = random() % (NUM_LEDS - 1);
    findRandom = false;
  }
  leds[spot - 1] = CRGB::Yellow;
  leds[spot] = CRGB::Green;
  leds[spot + 1] = CRGB::Yellow;
  FastLED.show();  
}

/**
 * Encender uno a uno los leds, apagando el anterior hasta completar la vuelta
 */
void playRound(byte bound1, byte bound2) {
  leds[position] = CRGB::Red;
  if (position < bound1 + 1 || position > bound2 + 1) {
    leds[position - 1] = CRGB::Black;
  }
  position++;
  if (position >= NUM_LEDS) {
    leds[position - 1] = CRGB::Black;
    position = 0;
  }
  FastLED.show();
}

/**
 * Acierto
 * Muestra todos los leds en verde y luego pasa al siguiente nivel
 */
void winner() {
  fill_solid(leds, NUM_LEDS, CRGB::Green);
  FastLED.show();
  delay(500);
  fill_solid(leds, NUM_LEDS, CRGB::Black);
  delay(500);  
  findRandom = true;
  position = 0;
  level++;
  if (level > MAX_LEVELS) {
    // you passed all levels
    level = 0;
    showMedal();
    restart();
  }
  showBadge();
  DEBUG_PRINT("Level: ");
  DEBUG_PRINT(level);
}

/**
 * Error
 * Muestra todos en rojo y resta una vida
 */
void loser() {
  lives--;
  if (lives > 0) {
    waiting = false;
    endRound();
  }
  else {
    for (int i = 0; i < 3; i++) {
      endRound();
    }
    lives = MAX_LIVES;
    level = 0;
  }
}

/**
 * Finalizar ronda mostrando todos los leds en rojo
 */
void endRound() {
  fill_solid(leds, NUM_LEDS, CRGB::Red);
  FastLED.show();
  delay(500);
  fill_solid(leds, NUM_LEDS, CRGB::Black);
  FastLED.show();
  delay(500);
}